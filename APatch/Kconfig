## APatch/Kconfig
```kconfig
menu "APatch Support"

config APATCH_SUPPORT
    bool "Enable Basic APatch support"
    default n
    select DEBUG_KERNEL
    select KALLSYMS
    select KALLSYMS_ALL
    select SYSFS_SYSCALL
    select SIGNALFD
    select TIMERFD
    select EVENTFD
    select OVERLAY_FS
    help
        This helps you to enable requirements for APatch.

config APATCH_FIX_MODULES
    tristate "Fix kernel modules in APatch"
    default y if APATCH_SUPPORT
    depends on APATCH_SUPPORT
    select MODULES
    select MODULE_FORCE_LOAD
    select MODULE_UNLOAD
    select MODULE_FORCE_UNLOAD
    select MODVERSIONS
    help
           Enable load modules.

endmenu
```
